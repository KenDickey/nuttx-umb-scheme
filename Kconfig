## Kconfig
```kconfig
config INTERPRETERS_UMB_SCHEME
        tristate "UMB-Scheme R4RS Scheme interpreter"
        default y
        ---help---
                Enable the UMB-Scheme `scheme` interpreter
		- Be sure to set CONFIG_LIBM=y in your .config file
		- Be sure to set CONFIG_ARCH_SETJMP_H=y in your .config file

if INTERPRETERS_UMB_SCHEME

config INTERPRETERS_UMB_SCHEME_PRIORITY
        int "UMB-Scheme task priority"
        default 100

config INTERPRETERS_UMB_SCHEME_STACKSIZE
        int "UMB-Scheme stack size"
	default 8192

endif
```
